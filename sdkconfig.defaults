## sdkconfig.defaults
```kconfig
CONFIG_IDF_TARGET="esp32"

CONFIG_ESPTOOLPY_FLASHSIZE_4MB=y

CONFIG_FREERTOS_HZ=1000

CONFIG_LOG_DEFAULT_LEVEL_INFO=y

CONFIG_COMPILER_OPTIMIZATION_SIZE=y

CONFIG_PARTITION_TABLE_CUSTOM=y
CONFIG_PARTITION_TABLE_CUSTOM_FILENAME="partitions.csv"

CONFIG_ESP_CONSOLE_UART_DEFAULT=y
```
